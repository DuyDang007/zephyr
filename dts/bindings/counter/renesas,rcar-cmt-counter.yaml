## dts/bindings/counter/renesas,rcar-cmt-counter.yaml
```yaml
description: Renesas R-Car Compare Match Timer counter

compatible: "renesas,rcar-cmt-counter"

include: base.yaml

properties:
  reg:
    required: true

  clocks:
    required: true

  interrupts:
    required: true

  clock-div:
    type: int
    default: 8
    description: Clock division ratio
    enum:
      - 8
      - 32
      - 128
```
